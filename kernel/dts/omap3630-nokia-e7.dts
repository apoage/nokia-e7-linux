// SPDX-License-Identifier: GPL-2.0-only
/*
 * Device tree for Nokia E7 on QEMU (Phase 1 — minimal boot)
 *
 * Include the full omap3.dtsi from mainline to get the clock tree,
 * then override with our board-specific bits.
 */

/dts-v1/;

#include "omap36xx.dtsi"

/ {
	model = "Nokia E7-00 (QEMU)";
	compatible = "nokia,rm626", "ti,omap3630", "ti,omap36xx", "ti,omap3";

	chosen {
		bootargs = "console=ttyS0,115200n8 earlycon earlyprintk";
		stdout-path = &uart3;
	};

	memory@80000000 {
		device_type = "memory";
		reg = <0x80000000 0x10000000>; /* 256 MB */
	};
};

&uart3 {
	status = "okay";
};
